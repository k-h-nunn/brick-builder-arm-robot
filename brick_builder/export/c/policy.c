/* policy.c: the exported actor's forward pass (PPO or SAC checkpoint -- see below).
 *
 * Plain C99, no dynamic allocation (the two scratch buffers below are fixed-size stack
 * arrays sized by POLICY_MAX_WIDTH, generated from the checkpoint's own layer sizes), and
 * no libm dependence beyond `tanhf` -- and none at all when built with -DPOLICY_TANH_TABLE,
 * which replaces `tanhf` with a linear-interpolation lookup table (tanh_table.h, generated
 * by actor_to_c.py:write_tanh_table). This mirrors brick_builder.rl.nets.Actor.forward exactly:
 * normalize with the frozen RunningNorm, then Linear -> tanh -> ... -> Linear (no activation
 * on the last layer), then a final squashing step that depends on which learner produced the
 * checkpoint (policy_theta.h's POLICY_SQUASH_TANH, generated by actor_to_c.py):
 *
 *   POLICY_SQUASH_TANH == 0: clamp the raw output to [low, high] (PPO,
 *   brick_builder.rl.ppo_asym.evaluate does the same clamp on the torch side).
 *   POLICY_SQUASH_TANH == 1: tanh(raw) * (high-low)/2 + (high+low)/2 (SAC,
 *   brick_builder.rl.sac_asym.select_action's "the deployed action is tanh(mean)" convention;
 *   this reuses policy_tanh, so the table-tanh build variant applies to this step too).
 *
 * This file, and policy.h beside it, are what will later be dropped unchanged into the
 * ESP32-P4 firmware tree (see docs/guide/07-export-and-firmware.md): everything checkpoint-
 * specific lives in the generated policy_theta.h this file includes, never in here.
 */
#include "policy.h"

#ifdef POLICY_TANH_TABLE
#include "tanh_table.h"

static float policy_tanh(float x)
{
    if (x <= TANH_TABLE_LO) return -1.0f;
    if (x >= TANH_TABLE_HI) return 1.0f;
    float pos = (x - TANH_TABLE_LO) * (float)(TANH_TABLE_N - 1) / (TANH_TABLE_HI - TANH_TABLE_LO);
    int i = (int)pos;
    if (i > TANH_TABLE_N - 2) i = TANH_TABLE_N - 2; /* guard the pos == N-1 edge case */
    float frac = pos - (float)i;
    return tanh_table[i] + frac * (tanh_table[i + 1] - tanh_table[i]);
}
#else
#include <math.h>

static float policy_tanh(float x)
{
    return tanhf(x);
}
#endif

void policy_act(const float *obs, float *act)
{
    float buf_a[POLICY_MAX_WIDTH];
    float buf_b[POLICY_MAX_WIDTH];
    int i, layer;

    for (i = 0; i < POLICY_OBS_DIM; i++) {
        float v = (obs[i] - policy_norm_mean[i]) * policy_norm_inv_std[i];
        if (v > POLICY_NORM_CLIP) v = POLICY_NORM_CLIP;
        if (v < -POLICY_NORM_CLIP) v = -POLICY_NORM_CLIP;
        buf_a[i] = v;
    }

    /* cur/scratch ping-pong between buf_a and buf_b so no layer's output buffer is also its
     * own input buffer; POLICY_MAX_WIDTH is the widest layer, so both always fit. */
    float *cur = buf_a;
    float *scratch = buf_b;
    int in_dim = POLICY_OBS_DIM;

    for (layer = 0; layer < POLICY_N_LAYERS; layer++) {
        int out_dim = policy_layer_out[layer];
        const float *w = policy_weights[layer]; /* row-major (out_dim, in_dim) */
        const float *b = policy_biases[layer];
        int o, k;

        for (o = 0; o < out_dim; o++) {
            float sum = b[o];
            const float *wrow = w + (long)o * in_dim;
            for (k = 0; k < in_dim; k++) {
                sum += wrow[k] * cur[k];
            }
            scratch[o] = (layer < POLICY_N_LAYERS - 1) ? policy_tanh(sum) : sum;
        }

        in_dim = out_dim;
        if (cur == buf_a) {
            cur = buf_b;
            scratch = buf_a;
        } else {
            cur = buf_a;
            scratch = buf_b;
        }
    }

#if POLICY_SQUASH_TANH
    for (i = 0; i < POLICY_ACT_DIM; i++) {
        float scale = 0.5f * (policy_act_high[i] - policy_act_low[i]);
        float bias = 0.5f * (policy_act_high[i] + policy_act_low[i]);
        act[i] = policy_tanh(cur[i]) * scale + bias;
    }
#else
    for (i = 0; i < POLICY_ACT_DIM; i++) {
        float v = cur[i];
        if (v < policy_act_low[i]) v = policy_act_low[i];
        if (v > policy_act_high[i]) v = policy_act_high[i];
        act[i] = v;
    }
#endif
}
